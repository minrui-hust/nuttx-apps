## examples/uwb_test/Kconfig
```kconfig
#
# For a description of the syntax of this configuration file,
# see the file kconfig-language.txt in the NuttX tools repository.
#

config EXAMPLES_UWB_TEST
	tristate "uwb test example"
	default n
	depends on INPUT_BUTTONS
	---help---
		Enable the Buttons drivers example

if EXAMPLES_UWB_TEST

config EXAMPLES_UWB_TEST_PROGNAME
	string "Program name"
	default "uwb_test"
	---help---
		This is the name of the program that will be used when the NSH ELF
		program is installed.

config EXAMPLES_UWB_TEST_PRIORITY
	int "task priority"
	default 100

config EXAMPLES_UWB_TEST_STACKSIZE
	int "stack size"
	default DEFAULT_TASK_STACKSIZE

config EXAMPLES_UWB_TEST_UWB_DEVPATH
	string "uwb device path"
	default "/dev/uwb0"

config EXAMPLES_UWB_TEST_BUTTON_DEVPATH
  string "Button device path"
  default "/dev/buttons"

endif # EXAMPLES_UWB_TEST
```
